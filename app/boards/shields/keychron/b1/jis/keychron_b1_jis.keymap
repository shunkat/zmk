ychron_b1_jis.keymap
/*
 * Copyright (c) 2023 The ZMK Contributors
 *
 * SPDX-License-Identifier: MIT
 */

#include <behaviors.dtsi>
#include <dt-bindings/zmk/keys.h>
#include <dt-bindings/zmk/rgb.h>
#include <dt-bindings/zmk/bt.h>
#include <dt-bindings/zmk/outputs.h>
#include <dt-bindings/zmk/mouse.h>

/ {
    ZMK_MACRO(recover, bindings = <&out OUT_RECOVER>;)
    ZMK_MACRO(change, bindings = <&out OUT_FN>;)
    ZMK_MACRO(fn_win, bindings = <&out OUT_FN_WIN>;)

    ZMK_MACRO(en_bootloader, bindings = <&bootloader>;)
    ZMK_MACRO1(MA,bindings=<&kp 0x770000>;)
    ZMK_MACRO(sleep_system, bindings = <&sys_reset>;) // Alternative for sleep system

    long_press_recover:l1 {
        compatible = "zmk,behavior-hold-tap";
        label = "l1";
        #binding-cells = <2>;
        flavor = "tap-preferred";
        tapping-term-ms = <3000>;  // delay amount in ms
        bindings = <&recover>, <&none>;
    };

    long_press_change:l2{
        compatible = "zmk,behavior-hold-tap";
        label = "lp_change";
        #binding-cells = <2>;
        flavor = "tap-preferred";
        tapping-term-ms = <3000>;  // delay amount in ms
        bindings = <&change>, <&none>;
    };
    long_press_bootloader:l3{
        compatible = "zmk,behavior-hold-tap";
        label = "lp_bootloader";
        #binding-cells = <2>;
        flavor = "tap-preferred";
        tapping-term-ms = <3000>;  // delay amount in ms
        bindings = <&en_bootloader>, <&none>;
    };
    long_press_fn_win:l4{
        compatible = "zmk,behavior-hold-tap";
        label = "lp_fn_win";
        #binding-cells = <2>;
        flavor = "tap-preferred";
        tapping-term-ms = <3000>;   
        bindings = <&fn_win>, <&none>;
    };
   

    combos1 {
        compatible = "zmk,combos";
        combo_jz {
            timeout-ms = <1000>;
            layers = <1 3>;
            key-positions = <49 57>; //fn+j+z
            bindings = <&long_press_recover 0 0>;
        };
        combo_xl {
            timeout-ms = <1000>;
            layers =< 1 3>;
            key-positions = <58 51>; //fn+x+l
            bindings = <&long_press_change 0 0>;
        };
        combo_b {
            timeout-ms = <1000>;
            layers =< 1 3>;
            //slow-release = <true>;
            key-positions = <61>; //fn+b
            bindings = <&out OUT_BAT>;
        };

        combo_win_l {
            timeout-ms = <1000>;
            layers =< 1 3>;
            //slow-release = <true>;
            key-positions = <70>; //fn+win
            bindings = <&long_press_fn_win 0 0>;
        };

        combo_t0 {
            timeout-ms = <10 >;
            layers =<4>;
          
            key-positions = <80 90>;  
            bindings = <&to 3 >;
        };
        combo_t1 {
            timeout-ms = <10 >;
            layers =<4>;
          
            key-positions = <80 91>;  
            bindings = <&tog 3 >;
        };
        combo_t2 {
            timeout-ms = <10 >;
            layers =<4>;
          
            key-positions = <80 92>;  
            bindings = <&sl 3 >;
        };
        combo_t3 {
            timeout-ms = <10 >;
            layers =<4>;
          
            key-positions = <70 93>;  
            bindings = <&lt 3 SPACE>;
        };
        combo_t4 {
            timeout-ms = <10 >;
            layers =<4>;
          
            key-positions = <81 94>;  
            bindings = <&sk LSHIFT>;
        };
        combo_t5 {
            timeout-ms = <10 >;
            layers =<4>;
          
            key-positions = <81 93>;  
            bindings = <&mt LSHIFT SPACE>;
        };
        combo_t6 {
            timeout-ms = <10 >;
            layers =<4>;
          
            key-positions = <81 93>;  
            bindings = <&gresc>;
        };
    };

    td0 {
        compatible = "zmk,behavior-tap-dance";
        label = "TAPD_LAYER";
        #binding-cells = <1>;
        tapping-term-ms = <350>;
        bindings =<&mo 0>,<&mo 0>,<&mo 0>,<&mo 0>,<&to 0>;
    };
    ZMK_MACRO(bt_pair0, bindings = <&bt BT_PAIR 0>;)
    ZMK_MACRO(bt_pair1, bindings = <&bt BT_PAIR 1>;)
    ZMK_MACRO(bt_pair2, bindings = <&bt BT_PAIR 2>;)
    ZMK_MACRO(bt_pair3, bindings = <&bt BT_PAIR 3>;)
    ZMK_MACRO(bt_recon_0, bindings = <&bt BT_SEL 0>;)
    ZMK_MACRO(bt_recon_1, bindings = <&bt BT_SEL 1>;)
    ZMK_MACRO(bt_recon_2, bindings = <&bt BT_SEL 2>;)
    ZMK_MACRO(bt_recon_3, bindings = <&bt BT_SEL 3>;)
    


    bt_pair_0: bt_pair_0 {
        compatible = "zmk,behavior-hold-tap";
        label = "bt_pair0";
        #binding-cells = <2>;
        flavor = "tap-preferred";
        tapping-term-ms = <3000>;  // delay amount in ms
        bindings = <&bt_pair0>, <&bt_recon_0>;
    };
    bt_pair_1: bt_pair_1 {
        compatible = "zmk,behavior-hold-tap";
        label = "bt_pair1";
        #binding-cells = <2>;
        flavor = "tap-preferred";
        tapping-term-ms = <3000>;  // delay amount in ms
        bindings = <&bt_pair1>, <&bt_recon_1>;
    };
    bt_pair_2: bt_pair_2 {
        compatible = "zmk,behavior-hold-tap";
        label = "bt_pair2";
        #binding-cells = <2>;
        flavor = "tap-preferred";
        tapping-term-ms = <3000>;  // delay amount in ms
        bindings = <&bt_pair2>, <&bt_recon_2>;
    };
    bt_pair_3: bt_pair_3 {
        compatible = "zmk,behavior-hold-tap";
        label = "bt_pair3";
        #binding-cells = <2>;
        flavor = "tap-preferred";
        tapping-term-ms = <3000>;  // delay amount in ms
        // filepath: /Users/user/Develop/others-repository/zmk/app/boards/shields/keychron/b1/jis/keychron_b1_jis.keymap
/*
 * Copyright (c) 2023 The ZMK Contributors
 *
 * SPDX-License-Identifier: MIT
 */

#include <behaviors.dtsi>
#include <dt-bindings/zmk/keys.h>
#include <dt-bindings/zmk/rgb.h>
#include <dt-bindings/zmk/bt.h>
#include <dt-bindings/zmk/outputs.h>
#include <dt-bindings/zmk/mouse.h>

/ {
    ZMK_MACRO(recover, bindings = <&out OUT_RECOVER>;)
    ZMK_MACRO(change, bindings = <&out OUT_FN>;)
    ZMK_MACRO(fn_win, bindings = <&out OUT_FN_WIN>;)

    ZMK_MACRO(en_bootloader, bindings = <&bootloader>;)
    ZMK_MACRO1(MA,bindings=<&kp 0x770000>;)
    ZMK_MACRO(sleep_system, bindings = <&sys_reset>;) // Alternative for sleep system

    long_press_recover:l1 {
        compatible = "zmk,behavior-hold-tap";
        label = "l1";
        #binding-cells = <2>;
        flavor = "tap-preferred";
        tapping-term-ms = <3000>;  // delay amount in ms
        bindings = <&recover>, <&none>;
    };

    long_press_change:l2{
        compatible = "zmk,behavior-hold-tap";
        label = "lp_change";
        #binding-cells = <2>;
        flavor = "tap-preferred";
        tapping-term-ms = <3000>;  // delay amount in ms
        bindings = <&change>, <&none>;
    };
    long_press_bootloader:l3{
        compatible = "zmk,behavior-hold-tap";
        label = "lp_bootloader";
        #binding-cells = <2>;
        flavor = "tap-preferred";
        tapping-term-ms = <3000>;  // delay amount in ms
        bindings = <&en_bootloader>, <&none>;
    };
    long_press_fn_win:l4{
        compatible = "zmk,behavior-hold-tap";
        label = "lp_fn_win";
        #binding-cells = <2>;
        flavor = "tap-preferred";
        tapping-term-ms = <3000>;   
        bindings = <&fn_win>, <&none>;
    };
   

    combos1 {
        compatible = "zmk,combos";
        combo_jz {
            timeout-ms = <1000>;
            layers = <1 3>;
            key-positions = <49 57>; //fn+j+z
            bindings = <&long_press_recover 0 0>;
        };
        combo_xl {
            timeout-ms = <1000>;
            layers =< 1 3>;
            key-positions = <58 51>; //fn+x+l
            bindings = <&long_press_change 0 0>;
        };
        combo_b {
            timeout-ms = <1000>;
            layers =< 1 3>;
            //slow-release = <true>;
            key-positions = <61>; //fn+b
            bindings = <&out OUT_BAT>;
        };

        combo_win_l {
            timeout-ms = <1000>;
            layers =< 1 3>;
            //slow-release = <true>;
            key-positions = <70>; //fn+win
            bindings = <&long_press_fn_win 0 0>;
        };

        combo_t0 {
            timeout-ms = <10 >;
            layers =<4>;
          
            key-positions = <80 90>;  
            bindings = <&to 3 >;
        };
        combo_t1 {
            timeout-ms = <10 >;
            layers =<4>;
          
            key-positions = <80 91>;  
            bindings = <&tog 3 >;
        };
        combo_t2 {
            timeout-ms = <10 >;
            layers =<4>;
          
            key-positions = <80 92>;  
            bindings = <&sl 3 >;
        };
        combo_t3 {
            timeout-ms = <10 >;
            layers =<4>;
          
            key-positions = <70 93>;  
            bindings = <&lt 3 SPACE>;
        };
        combo_t4 {
            timeout-ms = <10 >;
            layers =<4>;
          
            key-positions = <81 94>;  
            bindings = <&sk LSHIFT>;
        };
        combo_t5 {
            timeout-ms = <10 >;
            layers =<4>;
          
            key-positions = <81 93>;  
            bindings = <&mt LSHIFT SPACE>;
        };
        combo_t6 {
            timeout-ms = <10 >;
            layers =<4>;
          
            key-positions = <81 93>;  
            bindings = <&gresc>;
        };
    };

    td0 {
        compatible = "zmk,behavior-tap-dance";
        label = "TAPD_LAYER";
        #binding-cells = <1>;
        tapping-term-ms = <350>;
        bindings =<&mo 0>,<&mo 0>,<&mo 0>,<&mo 0>,<&to 0>;
    };
    ZMK_MACRO(bt_pair0, bindings = <&bt BT_PAIR 0>;)
    ZMK_MACRO(bt_pair1, bindings = <&bt BT_PAIR 1>;)
    ZMK_MACRO(bt_pair2, bindings = <&bt BT_PAIR 2>;)
    ZMK_MACRO(bt_pair3, bindings = <&bt BT_PAIR 3>;)
    ZMK_MACRO(bt_recon_0, bindings = <&bt BT_SEL 0>;)
    ZMK_MACRO(bt_recon_1, bindings = <&bt BT_SEL 1>;)
    ZMK_MACRO(bt_recon_2, bindings = <&bt BT_SEL 2>;)
    ZMK_MACRO(bt_recon_3, bindings = <&bt BT_SEL 3>;)
    


    bt_pair_0: bt_pair_0 {
        compatible = "zmk,behavior-hold-tap";
        label = "bt_pair0";
        #binding-cells = <2>;
        flavor = "tap-preferred";
        tapping-term-ms = <3000>;  // delay amount in ms
        bindings = <&bt_pair0>, <&bt_recon_0>;
    };
    bt_pair_1: bt_pair_1 {
        compatible = "zmk,behavior-hold-tap";
        label = "bt_pair1";
        #binding-cells = <2>;
        flavor = "tap-preferred";
        tapping-term-ms = <3000>;  // delay amount in ms
        bindings = <&bt_pair1>, <&bt_recon_1>;
    };
    bt_pair_2: bt_pair_2 {
        compatible = "zmk,behavior-hold-tap";
        label = "bt_pair2";
        #binding-cells = <2>;
        flavor = "tap-preferred";
        tapping-term-ms = <3000>;  // delay amount in ms
        bindings = <&bt_pair2>, <&bt_recon_2>;
    };
    bt_pair_3: bt_pair_3 {
        compatible = "zmk,behavior-hold-tap";
        label = "bt_pair3";
        #binding-cells = <2>;
        flavor = "tap-preferred";
        tapping-term-ms = <3000>;  // delay amount in ms
        